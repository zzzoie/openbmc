## meta-facebook/meta-agc032a/conf/machine/agc032a.conf
```bitbake
#@TYPE: Machine
#@NAME: AGC032A
#@DESCRIPTION: Machine configuration for AGC032A

require conf/machine/include/ast2520.inc

UBOOT_MACHINE_agc032a = "agc032a_config"
# PREFERRED_VERSION_u-boot = "v2019.01"
# PREFERRED_VERSION_u-boot = "${PV}" // ${PV} of openbmc/meta-aspeed/recipes-bsp/u-boot/*.bb
PREFERRED_VERSION_u-boot = "d2019.01"
PREFERRED_VERSION_u-boot-fw-utils = "d2019.01"

KERNEL_IMAGETYPE = "zImage"

KERNEL_DEVICETREE = "aspeed-bmc-delta-agc032a.dtb"
PREFERRED_VERSION_linux-aspeed = "5.6.19-delta"
PREFERRED_VERSION_libwatchdog = "0.2"
PREFERRED_VERSION_libipmi = "0.2"
PREFERRED_VERSION_ipmid = "0.2"
PREFERRED_VERSION_at93cx6-util = "0.1"
PREFERRED_VERSION_fscd = "0.3"
PREFERRED_VERSION_openbmc-gpio = "0.2"

MACHINE_ESSENTIAL_EXTRA_RDEPENDS += "           \
    kernel-module-i2c-dev-sysfs                 \
    kernel-module-i2c-dev-psu                   \
    kernel-module-cpld                          \
    kernel-module-i2c                           \
    "

SERIAL_CONSOLES += "115200;ttyS4"
```
